## configs/defconfig
```kconfig
# default config file, made by mkdefconfig

#
# System wide options
#
CONFIG_PROCS=n
CONFIG_STAND_ALONE=n

CONFIG_INCORE_RES=n
CONFIG_FIXED_MATH=y

CONFIG_DEBUG=n
CONFIG_TRACEMESSAGE=n
CONFIG_MSGSTR=n

CONFIG_CURSORSUPPORT=y
CONFIG_MOVEABLE=y
CONFIG_DBCLK=y

CONFIG_CLIPBOARD=y

CONFIG_OWN_MALLOC=n
CONFIG_OWN_STDIO=n

CONFIG_TIMERUNIT10MS=y

#
# GAL engine options
#
CONFIG_NEWGAL=y
CONFIG_GAL_NATIVE_COORTRANS_CW=n
CONFIG_GAL_NATIVE_COORTRANS_CCW=n
CONFIG_GAL_NATIVE_TEXTMODE=n

CONFIG_NEWGAL_ADV2DAPI=y

CONFIG_NEWGAL_DUMMY=y
CONFIG_NEWGAL_COMMONLCD=y
CONFIG_NEWGAL_SHADOW=y
CONFIG_NEWGAL_MLSHADOW=n

CONFIG_NEWGAL_FBCON=n
CONFIG_NEWGAL_QVFB=n
CONFIG_NEWGAL_WVFB=n

CONFIG_NEWGAL_EM85XXOSD=n
CONFIG_NEWGAL_EM85XXYUV=n
CONFIG_NEWGAL_EM86GFX=n
CONFIG_NEWGAL_SVPXXOSD=n
CONFIG_NEWGAL_BF533=n
CONFIG_NEWGAL_UTPMC=n
CONFIG_NEWGAL_MB93493=n
CONFIG_NEWGAL_DFB=n
CONFIG_NEWGAL_HI35XX=n

#
# IAL engine options
#

CONFIG_IAL_DUMMY=y
CONFIG_IAL_AUTO=y
CONFIG_IAL_RANDOM=y
CONFIG_IAL_QVFB=n
CONFIG_IAL_WVFB=n
CONFIG_IAL_COMMON=y

CONFIG_IAL_NATIVE=n
CONFIG_IAL_NATIVE_PS2MOUSE=n
CONFIG_IAL_NATIVE_IMPS2MOUSE=n
CONFIG_IAL_NATIVE_MSMOUSE=n
CONFIG_IAL_NATIVE_MS3MOUSE=n
CONFIG_IAL_NATIVE_GPM=n

CONFIG_IAL_EP7211=n
CONFIG_IAL_ADS=n
CONFIG_IAL_IPAQ=n
CONFIG_IAL_FIGUEROA=n
CONFIG_IAL_L7200=n
CONFIG_IAL_ARM3000=n

CONFIG_IAL_DM270=n
CONFIG_IAL_EVMV10=n
CONFIG_IAL_FFT7202=n
CONFIG_IAL_PALMII=n
CONFIG_IAL_MPC823=n

CONFIG_IAL_UCB1X00=n
CONFIG_IAL_PX255B=n
CONFIG_IAL_VR4181=n
CONFIG_IAL_HELIO=n
CONFIG_IAL_TFSTB=n

CONFIG_IAL_MTT800=n
CONFIG_IAL_MC68X328=n
CONFIG_IAL_SMDK2410=n
CONFIG_IAL_HH2410R3=n
CONFIG_IAL_HH2440=n

CONFIG_IAL_SKYEYEEP7312=n
CONFIG_IAL_DMGSTB=n
CONFIG_IAL_SVPXX=n
CONFIG_IAL_FIP=n
CONFIG_IAL_ADS7846=n

CONFIG_IAL_EM85=n
CONFIG_IAL_EM86=n
CONFIG_IAL_EM8620=n
CONFIG_IAL_HHKBDIR=n
CONFIG_IAL_UTPMC=n

CONFIG_IAL_FXRM9200=n
CONFIG_IAL_ABSSIG=n
CONFIG_IAL_EMBEST2410=n
CONFIG_IAL_EMBEST44B0=n
CONFIG_IAL_THOR=n
CONFIG_IAL_DFB=n
CONFIG_IAL_HI3510=n

#
# Font options
#
CONFIG_FONT_RBF=y

CONFIG_FONT_INCORE24=n
CONFIG_FONT_INCOREGB12=y
CONFIG_FONT_INCOREGB16=y
CONFIG_FONT_INCOREGB24=n
CONFIG_FONT_INCOREGB16_HEI=n
CONFIG_FONT_INCOREBIG12=n
CONFIG_FONT_INCOREBIG16=n
CONFIG_FONT_INCOREBIG24=n
CONFIG_FONT_INCOREKJ12=n
CONFIG_FONT_INCOREKJ14=n
CONFIG_FONT_INCOREKJ16=n

CONFIG_FONT_VBF=y
CONFIG_FONT_INCORESSERIF=y
CONFIG_FONT_INCORECOURIER=y
CONFIG_FONT_INCORESYMBOL=y
CONFIG_FONT_INCOREVGAS=y
CONFIG_FONT_QPF=y
CONFIG_FONT_TTF=y
CONFIG_FONT_TTFCACHE=n
CONFIG_FONT_TYPE1=n

#
# Charset options
#
CONFIG_CHARSET_LATIN2=n
CONFIG_CHARSET_LATIN3=n
CONFIG_CHARSET_LATIN4=n
CONFIG_CHARSET_CYRILLIC=n
CONFIG_CHARSET_ARABIC=n
CONFIG_CHARSET_GREEK=n
CONFIG_CHARSET_HEBREW=n
CONFIG_CHARSET_LATIN5=n
CONFIG_CHARSET_LATIN6=n
CONFIG_CHARSET_THAI=n
CONFIG_CHARSET_LATIN7=n
CONFIG_CHARSET_LATIN8=n
CONFIG_CHARSET_LATIN9=y
CONFIG_CHARSET_LATIN10=n
CONFIG_CHARSET_GB2312=y
CONFIG_CHARSET_GBK=y
CONFIG_CHARSET_GB18030=n
CONFIG_CHARSET_BIG5=y
CONFIG_CHARSET_EUCKR=n
CONFIG_CHARSET_EUCJP=n
CONFIG_CHARSET_SHIFTJIS=n
CONFIG_CHARSET_UNICODE=y

#
# Keyboard layout specific options
#
CONFIG_KBD_FRPC=n
CONFIG_KBD_FR=n
CONFIG_KBD_DE=n
CONFIG_KBD_DELATIN1=n
CONFIG_KBD_IT=n
CONFIG_KBD_ES=n
CONFIG_KBD_ESCP850=n

#
# Image options
#
CONFIG_IMAGE_SAVEBMP=y
CONFIG_IMAGE_PCX=n
CONFIG_IMAGE_LBM=n
CONFIG_IMAGE_TGA=n
CONFIG_IMAGE_GIF=y
CONFIG_IMAGE_JPG=y
CONFIG_IMAGE_PNG=y

#
# Input method options
#
CONFIG_IME_GB2312=y
CONFIG_IME_GB2312PINYIN=y

#
# Appearance options
#
CONFIG_APPEARANCE_CLASSICSTYLE=y
CONFIG_APPEARANCE_FLATSTYLE=n
CONFIG_APPEARANCE_FASHIONESTYLE=n
CONFIG_APPEARANCE_TINYSCR=n

#
# Misc options
#
CONFIG_MISC_MOUSECALIBRATE=y
CONFIG_MISC_ABOUTDLG=y
CONFIG_MISC_SAVESCR=y

#
# Controls options
#
CONFIG_CTRL_STATIC=y
CONFIG_CTRL_BUTTON=y
CONFIG_CTRL_SIMEDIT=y
CONFIG_CTRL_SLEDIT=y
CONFIG_CTRL_LISTBOX=y
CONFIG_CTRL_PROGRESSBAR=y
CONFIG_CTRL_TOOLBAR=y
CONFIG_CTRL_NEWTOOLBAR=y
CONFIG_CTRL_MENUBUTTON=y
CONFIG_CTRL_TRACKBAR=y
CONFIG_CTRL_COMBOBOX=y
CONFIG_CTRL_PROPSHEET=y
CONFIG_CTRL_SCROLLVIEW=y
CONFIG_CTRL_TEXTEDIT=y

#
# Ext library options
#
CONFIG_EXT_TREEVIEW=y
CONFIG_EXT_LISTVIEW=y
CONFIG_EXT_MONTHCAL=y
CONFIG_EXT_SPINBOX=y
CONFIG_EXT_COOLBAR=y
CONFIG_EXT_ANIMATION=y
CONFIG_EXT_ICONVIEW=y
CONFIG_EXT_GRIDVIEW=y
CONFIG_EXT_SKIN=y

CONFIG_LIBVCONGUI=y

CONFIG_OS_LINUX=y
CONFIG_COMPILER_X86=y
CONFIG_LIBC_GLIBC=y

#
# Baler options
#
PACK_OS_LINUX=n
PACK_OS_UCLINUX=n
PACK_OS_ECOS=n
PACK_OS_UCOSII=n
PACK_OS_VXWORKS=n
PACK_OS_OSE=n
PACK_OS_WIN32=n
PACK_OS_DARWIN=n
PACK_OS_THREADX=n
PACK_OS_NUCLEUS=n
PACK_OS_PSOS=n

PACK_OWN_MALLOC=n
PACK_OWN_STDIO=n

PACK_FONT_INCOREGB12=y
PACK_FONT_INCOREGB16=y
PACK_FONT_INCOREGB24=n
PACK_FONT_INCOREGB16_HEI=n
PACK_FONT_INCOREBIG12=n
PACK_FONT_INCOREBIG16=n
PACK_FONT_INCOREBIG24=n
PACK_FONT_INCOREKJ12=n
PACK_FONT_INCOREKJ14=n
PACK_FONT_INCOREKJ16=n
```
